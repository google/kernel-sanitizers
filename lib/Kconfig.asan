## lib/Kconfig.asan
```kconfig
config HAVE_ARCH_ASAN
	bool

if HAVE_ARCH_ASAN

config ASAN
	bool "AddressSanitizer: dynamic memory error detector"
	depends on SLAB
	depends on !DEBUG_SLAB
	depends on !DEBUG_PAGEALLOC
	depends on !KMEMCHECK
	default n
	help
	  Enables AddressSanitizer - dynamic memory error detector,
	  that finds out-of-bounds and use-after-free bugs.

config ASAN_QUARANTINE_SIZE
	int "AddressSanitizer: quarantine size in MB"
	depends on ASAN
	default 128
	help
	  Select the maximum total size of quarantine in MB.
	  AddressSanitizer puts memory blocks in quarantine instead of
	  freeing them so they are not reallocated and reused any time soon.

config ASAN_SHADOW_OFFSET
	hex "AddressSanitizer: offset of shadow memory"
	depends on ASAN
	default 0x36400600
	help
	  Select the offset in bytes of the shadow memory region
	  within the physical memory.

config ASAN_STACK_ORDER_ADD
	hex "AddressSanitizer: enlarge stacks order"
	depends on ASAN
	default 2
	help
	  Enlarge all stacks 2^this_value times

endif
```

## lib/Kconfig.kasan
```kconfig
config HAVE_ARCH_KASAN
	bool

if HAVE_ARCH_KASAN

config KASAN
	bool "AddressSanitizer: runtime memory debugger"
	depends on !MEMORY_HOTPLUG
	depends on SLUB_DEBUG
	help
	  Enables address sanitizer - runtime memory debugger,
	  designed to find out-of-bounds accesses and use-after-free bugs.
	  This is strictly debugging feature. It consumes about 1/8
	  of available memory and brings about ~x3 performance slowdown.
	  For better error detection enable CONFIG_STACKTRACE,
	  and add slub_debug=U to boot cmdline.

config KASAN_SHADOW_OFFSET
	hex
	default 0xdfffe90000000000 if X86_64

endif
```

## lib/Kconfig.kcsan
```kconfig
# SPDX-License-Identifier: GPL-2.0-only

config HAVE_ARCH_KCSAN
	bool

menuconfig KCSAN
	bool "KCSAN: watchpoint-based dynamic data-race detector"
	depends on HAVE_ARCH_KCSAN && !KASAN && STACKTRACE
	default n
	help
	  Kernel Concurrency Sanitizer is a dynamic data-race detector, which
	  uses a watchpoint-based sampling approach to detect races.

if KCSAN

config KCSAN_EARLY_ENABLE
	bool "KCSAN: early enable"
	default y
	help
	  If KCSAN should be enabled globally as soon as possible. KCSAN can
	  later be enabled/disabled by writing on/off to /proc/kcsaninfo.

config KCSAN_UDELAY_MAX_TASK
	int "KCSAN: maximum delay in microseconds (for tasks)"
	default 80
	help
	  For tasks, the max. microsecond delay after setting up a watchpoint.

config KCSAN_UDELAY_MAX_INTERRUPT
	int "KCSAN: maximum delay in microseconds (for interrupts)"
	default 20
	help
	  For interrupts, the max. microsecond delay after setting up a watchpoint.

config KCSAN_DELAY_RANDOMIZE
	bool "KCSAN: randomize delays"
	default y
	help
	  If delays should be randomized; if false, the chosen delay is simply
	  the maximum values defined above.

config KCSAN_WATCH_SKIP_INST
	int "KCSAN: watchpoint instruction skip"
	default 2000
	help
	  The number of per-CPU memory operations to skip watching, before
	  another watchpoint is set up; in other words, 1 in
	  KCSAN_WATCH_SKIP_INST per-CPU memory operations are used to set up a
	  watchpoint. A smaller value results in more aggressive race
	  detection, whereas a larger value improves system performance at the
	  cost of missing some races.

config KCSAN_REPORT_RACE_UNKNOWN_ORIGIN
	bool "KCSAN: report races of unknown origin"
	default y
	help
	  If KCSAN should report races where only one access is known, and the
	  conflicting access is of unknown origin. This type of race is
	  reported if it was only possible to infer a race due to a data-value
	  change while an access is being delayed on a watchpoint.

config KCSAN_IGNORE_ATOMICS
	bool "KCSAN: do not instrument atomic accesses"
	default n
	help
	  If enabled, never instruments atomic accesses. This results in not
	  reporting data-races where one access is atomic and the other is a
	  plain access.

config KCSAN_PLAIN_WRITE_PRETEND_ONCE
	bool "KCSAN: pretend plain writes are WRITE_ONCE"
	default n
	help
	  This option makes KCSAN pretend that all plain writes are WRITE_ONCE.
	  This option should only be used to prune initial data-races found in
	  existing code. Please see the LKMM for more guidance.

config KCSAN_DEBUG
	bool "Debugging of KCSAN internals"
	default n

endif # KCSAN
```

## lib/Kconfig.kfence
```kconfig
config HAVE_ARCH_KFENCE
	bool

menuconfig KFENCE
	bool "KFENCE: low-overhead use-after-free and buffer-overflow detector"
	depends on HAVE_ARCH_KFENCE && !KASAN && (SLAB || SLUB)
	depends on JUMP_LABEL # To ensure performance, require jump labels
	help
	  KFENCE is low-overhead sampling-based detector for heap
	  use-after-free and buffer-overflow errors. KFENCE is designed to have
	  negligible cost to permit enabling it in production environments.

	  See <file:Documentation/dev-tools/kfence.rst> for more details.

	  Note that, KFENCE is not a substitute for explicit testing with tools
	  such as KASAN. KFENCE can detect a subset of bugs that KASAN can
	  detect (therefore enabling KFENCE together with KASAN does not make
	  sense), albeit at very different performance profiles.

if KFENCE

config KFENCE_SAMPLE_RATE
	int "Default sample rate in milliseconds"
	default 100
	help
	  The KFENCE sample rate determines the frequency with which heap
	  allocations will be guarded by KFENCE. May be overridden via
	  command-line argument kfence.sample_rate.

config KFENCE_NUM_OBJECTS
	int "Number of guarded objects available"
	default 255
	range 1 65535
	help
	  The number of guarded objects available. For each KFENCE object, 2
	  pages are required; with one containing the object and two adjacent
	  ones used as redzones.

config KFENCE_FAULT_INJECTION
	int "Fault injection for stress testing"
	default 0
	depends on EXPERT
	help
	  The inverse probability with which to randomly protect KFENCE object
	  pages, resulting in spurious use-after-frees. The main purpose of
	  this option is to stress-test KFENCE with concurrent error reports
	  and allocations/frees. A value of 0 disables fault injection.

endif # KFENCE
```
